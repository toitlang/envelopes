## variants/esp32-eth-clk-out17/sdkconfig.defaults.patch
```kconfig
--- toit/toolchains/esp32/sdkconfig.defaults
+++ synthesized/esp32-eth-clk-out17/sdkconfig.defaults
@@ -9,7 +9,6 @@
 CONFIG_PARTITION_TABLE_CUSTOM=y
 CONFIG_COMPILER_OPTIMIZATION_SIZE=y
 CONFIG_COMPILER_OPTIMIZATION_ASSERTIONS_DISABLE=y
-CONFIG_COMPILER_ORPHAN_SECTIONS_PLACE=y
 CONFIG_BT_ENABLED=y
 CONFIG_BT_NIMBLE_ENABLED=y
 CONFIG_BT_NIMBLE_MEM_ALLOC_MODE_DEFAULT=y
@@ -30,14 +29,13 @@
 CONFIG_ADC_CAL_EFUSE_TP_ENABLE=n
 CONFIG_ADC_CAL_LUT_ENABLE=n
 CONFIG_I2S_ISR_IRAM_SAFE=y
-CONFIG_SPI_MASTER_ISR_IN_IRAM=y
 CONFIG_SPI_SLAVE_ISR_IN_IRAM=n
 CONFIG_UART_ISR_IN_IRAM=y
+CONFIG_ETH_RMII_CLK_OUTPUT=y
 CONFIG_ETH_SPI_ETHERNET_DM9051=y
 CONFIG_ETH_SPI_ETHERNET_W5500=y
 CONFIG_ESP_HTTP_CLIENT_ENABLE_HTTPS=n
 CONFIG_ESP_SLEEP_GPIO_RESET_WORKAROUND=y
-CONFIG_PERIPH_CTRL_FUNC_IN_IRAM=n
 CONFIG_XTAL_FREQ_AUTO=y
 CONFIG_ESP_PHY_CALIBRATION_AND_DATA_STORAGE=n
 CONFIG_ESP_DEFAULT_CPU_FREQ_MHZ_240=y
@@ -49,7 +47,6 @@
 CONFIG_ESP_WIFI_NVS_ENABLED=n
 CONFIG_ESP_WIFI_TASK_PINNED_TO_CORE_1=y
 CONFIG_ESP_WIFI_IRAM_OPT=n
-CONFIG_ESP_WIFI_GMAC_SUPPORT=n
 CONFIG_FATFS_LFN_HEAP=y
 CONFIG_FREERTOS_THREAD_LOCAL_STORAGE_POINTERS=3
 CONFIG_FREERTOS_IDLE_TASK_STACKSIZE=1024
@@ -59,15 +56,12 @@
 CONFIG_LWIP_LOCAL_HOSTNAME="toit"
 CONFIG_LWIP_DNS_SUPPORT_MDNS_QUERIES=n
 CONFIG_LWIP_TCP_SYNMAXRTX=6
-CONFIG_LWIP_HOOK_IP6_INPUT_NONE=y
 CONFIG_MBEDTLS_SSL_IN_CONTENT_LEN=7800
 CONFIG_MBEDTLS_SSL_OUT_CONTENT_LEN=3700
 CONFIG_MBEDTLS_DYNAMIC_BUFFER=y
 CONFIG_MBEDTLS_X509_TRUSTED_CERT_CALLBACK=y
 CONFIG_MBEDTLS_SSL_KEEP_PEER_CERTIFICATE=n
-CONFIG_MBEDTLS_ECP_RESTARTABLE=y
 CONFIG_MBEDTLS_TLS_CLIENT_ONLY=y
-CONFIG_MBEDTLS_ECP_FIXED_POINT_OPTIM=y
 CONFIG_MBEDTLS_POLY1305_C=y
 CONFIG_MBEDTLS_CHACHA20_C=y
 CONFIG_MBEDTLS_CHACHAPOLY_C=y
```

## variants/esp32-spiram-rev3/sdkconfig.defaults.patch
```kconfig
--- toit/toolchains/esp32/sdkconfig.defaults
+++ synthesized/esp32-spiram-rev3/sdkconfig.defaults
@@ -35,19 +35,20 @@
 CONFIG_ETH_SPI_ETHERNET_DM9051=y
 CONFIG_ETH_SPI_ETHERNET_W5500=y
 CONFIG_ESP_HTTP_CLIENT_ENABLE_HTTPS=n
+CONFIG_ESP32_REV_MIN_3=y
 CONFIG_ESP_SLEEP_GPIO_RESET_WORKAROUND=y
 CONFIG_PERIPH_CTRL_FUNC_IN_IRAM=y
 CONFIG_XTAL_FREQ_AUTO=y
 CONFIG_ESP_PHY_CALIBRATION_AND_DATA_STORAGE=n
+CONFIG_SPIRAM=y
+CONFIG_SPIRAM_IGNORE_NOTFOUND=y
 CONFIG_ESP_DEFAULT_CPU_FREQ_MHZ_240=y
-CONFIG_ESP_INT_WDT=n
 CONFIG_ESP_TASK_WDT_INIT=n
 CONFIG_ESP_DEBUG_OCDAWARE=n
 CONFIG_ESP_WIFI_DYNAMIC_RX_BUFFER_NUM=16
 CONFIG_ESP_WIFI_DYNAMIC_TX_BUFFER_NUM=16
 CONFIG_ESP_WIFI_NVS_ENABLED=n
 CONFIG_ESP_WIFI_TASK_PINNED_TO_CORE_1=y
-CONFIG_ESP_WIFI_IRAM_OPT=n
 CONFIG_ESP_WIFI_GMAC_SUPPORT=n
 CONFIG_FATFS_LFN_HEAP=y
 CONFIG_FREERTOS_THREAD_LOCAL_STORAGE_POINTERS=3
```

## variants/esp32-spiram/sdkconfig.defaults.patch
```kconfig
--- toit/toolchains/esp32/sdkconfig.defaults
+++ synthesized/esp32-spiram/sdkconfig.defaults
@@ -40,6 +40,8 @@
 CONFIG_PERIPH_CTRL_FUNC_IN_IRAM=n
 CONFIG_XTAL_FREQ_AUTO=y
 CONFIG_ESP_PHY_CALIBRATION_AND_DATA_STORAGE=n
+CONFIG_SPIRAM=y
+CONFIG_SPIRAM_IGNORE_NOTFOUND=y
 CONFIG_ESP_DEFAULT_CPU_FREQ_MHZ_240=y
 CONFIG_ESP_INT_WDT=n
 CONFIG_ESP_TASK_WDT_INIT=n
@@ -48,7 +50,6 @@
 CONFIG_ESP_WIFI_DYNAMIC_TX_BUFFER_NUM=16
 CONFIG_ESP_WIFI_NVS_ENABLED=n
 CONFIG_ESP_WIFI_TASK_PINNED_TO_CORE_1=y
-CONFIG_ESP_WIFI_IRAM_OPT=n
 CONFIG_ESP_WIFI_GMAC_SUPPORT=n
 CONFIG_FATFS_LFN_HEAP=y
 CONFIG_FREERTOS_THREAD_LOCAL_STORAGE_POINTERS=3
@@ -77,5 +78,6 @@
 CONFIG_SPI_FLASH_LOG_FAILED_WRITE=y
 CONFIG_SPI_FLASH_WARN_SETTING_ZERO_TO_ONE=y
 CONFIG_WS_TRANSPORT=n
+CONFIG_TOIT_INTERPRETER_IN_IRAM=n
 CONFIG_TOIT_INTERPRETER_HELPERS_IN_IRAM=n
 CONFIG_TOIT_CRYPTO_EXTRA=y
```

## variants/esp32c6-fat/sdkconfig.defaults.patch
```kconfig
--- toit/toolchains/esp32c6/sdkconfig.defaults
+++ synthesized/esp32c6-fat/sdkconfig.defaults
@@ -67,5 +67,4 @@
 CONFIG_SPI_FLASH_LOG_FAILED_WRITE=y
 CONFIG_SPI_FLASH_WARN_SETTING_ZERO_TO_ONE=y
 CONFIG_WS_TRANSPORT=n
-CONFIG_TOIT_FATFS=n
 CONFIG_TOIT_CRYPTO_EXTRA=y
```

## variants/esp32c6-no-ble/sdkconfig.defaults.patch
```kconfig
--- toit/toolchains/esp32c6/sdkconfig.defaults
+++ synthesized/esp32c6-no-ble/sdkconfig.defaults
@@ -11,18 +11,6 @@
 CONFIG_PARTITION_TABLE_CUSTOM=y
 CONFIG_COMPILER_OPTIMIZATION_SIZE=y
 CONFIG_COMPILER_OPTIMIZATION_ASSERTIONS_DISABLE=y
-CONFIG_COMPILER_ORPHAN_SECTIONS_PLACE=y
-CONFIG_BT_ENABLED=y
-CONFIG_BT_NIMBLE_ENABLED=y
-CONFIG_BT_NIMBLE_MEM_ALLOC_MODE_DEFAULT=y
-CONFIG_BT_NIMBLE_LOG_LEVEL_NONE=y
-CONFIG_BT_NIMBLE_MAX_CONNECTIONS=2
-CONFIG_BT_NIMBLE_MAX_BONDS=4
-CONFIG_BT_NIMBLE_MAX_CCCDS=3
-CONFIG_BT_NIMBLE_NVS_PERSIST=y
-CONFIG_BT_NIMBLE_SVC_GAP_DEVICE_NAME="toit"
-CONFIG_BT_NIMBLE_SVC_GAP_APPEARANCE=0x0
-CONFIG_BT_NIMBLE_TRANSPORT_ACL_FROM_LL_COUNT=10
 CONFIG_I2S_ISR_IRAM_SAFE=y
 CONFIG_UART_ISR_IN_IRAM=y
 CONFIG_ETH_USE_SPI_ETHERNET=n
@@ -47,7 +35,6 @@
 CONFIG_LWIP_LOCAL_HOSTNAME="toit"
 CONFIG_LWIP_DNS_SUPPORT_MDNS_QUERIES=n
 CONFIG_LWIP_TCP_SYNMAXRTX=6
-CONFIG_LWIP_HOOK_IP6_INPUT_NONE=y
 CONFIG_MBEDTLS_SSL_IN_CONTENT_LEN=7800
 CONFIG_MBEDTLS_SSL_OUT_CONTENT_LEN=3700
 CONFIG_MBEDTLS_DYNAMIC_BUFFER=y
```

## variants/esp32s2-cdc/sdkconfig.defaults.patch
```kconfig
--- toit/toolchains/esp32s2/sdkconfig.defaults
+++ synthesized/esp32s2-cdc/sdkconfig.defaults
@@ -25,6 +25,7 @@
 CONFIG_SPIRAM_USE_CAPS_ALLOC=y
 CONFIG_SPIRAM_TRY_ALLOCATE_WIFI_LWIP=y
 CONFIG_ESP_DEFAULT_CPU_FREQ_MHZ_240=y
+CONFIG_ESP_CONSOLE_USB_CDC=y
 CONFIG_ESP_INT_WDT=n
 CONFIG_ESP_TASK_WDT_INIT=n
 CONFIG_ESP_WIFI_DYNAMIC_RX_BUFFER_NUM=16
```

## variants/esp32s3-audio/sdkconfig.defaults.patch
```kconfig
--- toit/toolchains/esp32s3/sdkconfig.defaults
+++ synthesized/esp32s3-audio/sdkconfig.defaults
@@ -25,7 +25,6 @@
 CONFIG_BT_NIMBLE_TRANSPORT_ACL_FROM_LL_COUNT=10
 CONFIG_BT_CTRL_BLE_MAX_ACT=10
 CONFIG_I2S_ISR_IRAM_SAFE=y
-CONFIG_SPI_SLAVE_ISR_IN_IRAM=y
 CONFIG_UART_ISR_IN_IRAM=y
 CONFIG_ETH_SPI_ETHERNET_DM9051=y
 CONFIG_ETH_SPI_ETHERNET_W5500=y
@@ -71,4 +70,7 @@
 CONFIG_SPI_FLASH_LOG_FAILED_WRITE=y
 CONFIG_SPI_FLASH_WARN_SETTING_ZERO_TO_ONE=y
 CONFIG_WS_TRANSPORT=n
+CONFIG_TOIT_AUDIO=y
+CONFIG_TOIT_AUDIO_EXTRA=y
+CONFIG_TOIT_AUDIO_FLOAT_FFT=y
 CONFIG_TOIT_CRYPTO_EXTRA=y
```
