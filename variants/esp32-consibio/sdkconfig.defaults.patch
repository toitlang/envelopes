## variants/esp32-consibio/sdkconfig.defaults.patch
```kconfig
--- toit/toolchains/esp32/sdkconfig.defaults	2025-08-20 22:17:50.661701198 +0200
+++ synthesized/esp32-consibio/sdkconfig.defaults	2025-08-20 22:18:06.283432594 +0200
@@ -5,28 +5,10 @@
 CONFIG_BOOTLOADER_APP_ROLLBACK_ENABLE=y
 CONFIG_BOOTLOADER_SKIP_VALIDATE_IN_DEEP_SLEEP=y
 CONFIG_APP_COMPILE_TIME_DATE=n
-CONFIG_ESPTOOLPY_FLASHSIZE_4MB=y
+CONFIG_ESPTOOLPY_FLASHSIZE_16MB=y
 CONFIG_PARTITION_TABLE_CUSTOM=y
 CONFIG_COMPILER_OPTIMIZATION_SIZE=y
 CONFIG_COMPILER_OPTIMIZATION_ASSERTIONS_DISABLE=y
-CONFIG_COMPILER_ORPHAN_SECTIONS_PLACE=y
-CONFIG_BT_ENABLED=y
-CONFIG_BT_NIMBLE_ENABLED=y
-CONFIG_BT_NIMBLE_MEM_ALLOC_MODE_DEFAULT=y
-CONFIG_BT_NIMBLE_LOG_LEVEL_NONE=y
-CONFIG_BT_NIMBLE_MAX_CONNECTIONS=2
-CONFIG_BT_NIMBLE_MAX_BONDS=4
-CONFIG_BT_NIMBLE_MAX_CCCDS=3
-CONFIG_BT_NIMBLE_PINNED_TO_CORE_1=y
-CONFIG_BT_NIMBLE_NVS_PERSIST=y
-CONFIG_BT_NIMBLE_SVC_GAP_DEVICE_NAME="toit"
-CONFIG_BT_NIMBLE_SVC_GAP_APPEARANCE=0x0
-CONFIG_BT_NIMBLE_TRANSPORT_ACL_FROM_LL_COUNT=10
-CONFIG_BTDM_CTRL_BLE_MAX_CONN=2
-CONFIG_BTDM_CTRL_PINNED_TO_CORE_1=y
-CONFIG_BTDM_CTRL_MODEM_SLEEP=n
-CONFIG_BTDM_BLE_SCAN_DUPL=n
-CONFIG_BTDM_BLE_ADV_REPORT_FLOW_CTRL_NUM=50
 CONFIG_ADC_CAL_EFUSE_TP_ENABLE=n
 CONFIG_ADC_CAL_LUT_ENABLE=n
 CONFIG_I2S_ISR_IRAM_SAFE=y
@@ -47,7 +29,6 @@
 CONFIG_ESP_WIFI_NVS_ENABLED=n
 CONFIG_ESP_WIFI_TASK_PINNED_TO_CORE_1=y
 CONFIG_ESP_WIFI_IRAM_OPT=n
-CONFIG_ESP_WIFI_GMAC_SUPPORT=n
 CONFIG_FATFS_LFN_HEAP=y
 CONFIG_FREERTOS_THREAD_LOCAL_STORAGE_POINTERS=3
 CONFIG_FREERTOS_IDLE_TASK_STACKSIZE=1024
@@ -57,14 +38,12 @@
 CONFIG_LWIP_LOCAL_HOSTNAME="toit"
 CONFIG_LWIP_DNS_SUPPORT_MDNS_QUERIES=n
 CONFIG_LWIP_TCP_SYNMAXRTX=6
-CONFIG_LWIP_HOOK_IP6_INPUT_NONE=y
 CONFIG_MBEDTLS_SSL_IN_CONTENT_LEN=7800
 CONFIG_MBEDTLS_SSL_OUT_CONTENT_LEN=3700
 CONFIG_MBEDTLS_X509_TRUSTED_CERT_CALLBACK=y
 CONFIG_MBEDTLS_ECP_RESTARTABLE=y
 CONFIG_MBEDTLS_HARDWARE_MPI=n
 CONFIG_MBEDTLS_TLS_CLIENT_ONLY=y
-CONFIG_MBEDTLS_ECP_FIXED_POINT_OPTIM=y
 CONFIG_MBEDTLS_POLY1305_C=y
 CONFIG_MBEDTLS_CHACHA20_C=y
 CONFIG_MBEDTLS_CHACHAPOLY_C=y
@@ -74,4 +53,3 @@
 CONFIG_SPI_FLASH_LOG_FAILED_WRITE=y
 CONFIG_SPI_FLASH_WARN_SETTING_ZERO_TO_ONE=y
 CONFIG_WS_TRANSPORT=n
-CONFIG_TOIT_INTERPRETER_HELPERS_IN_IRAM=n
```

## variants/esp32-different-console/sdkconfig.defaults.patch
```kconfig
--- toit/toolchains/esp32/sdkconfig.defaults
+++ synthesized/esp32-different-console/sdkconfig.defaults
@@ -38,6 +38,9 @@
 CONFIG_XTAL_FREQ_AUTO=y
 # CONFIG_ESP_PHY_CALIBRATION_AND_DATA_STORAGE is not set
 CONFIG_ESP_DEFAULT_CPU_FREQ_MHZ_240=y
+CONFIG_ESP_CONSOLE_UART_CUSTOM=y
+CONFIG_ESP_CONSOLE_UART_TX_GPIO=12
+CONFIG_ESP_CONSOLE_UART_RX_GPIO=14
 # CONFIG_ESP_INT_WDT is not set
 # CONFIG_ESP_TASK_WDT_INIT is not set
 # CONFIG_ESP_DEBUG_OCDAWARE is not set
```

## variants/esp32-eth-clk-out0-spiram/sdkconfig.defaults.patch
```kconfig
--- toit/toolchains/esp32/sdkconfig.defaults	2025-08-20 22:17:50.661701198 +0200
+++ synthesized/esp32-eth-clk-out0-spiram/sdkconfig.defaults	2025-08-20 22:18:16.761227223 +0200
@@ -9,7 +9,6 @@
 CONFIG_PARTITION_TABLE_CUSTOM=y
 CONFIG_COMPILER_OPTIMIZATION_SIZE=y
 CONFIG_COMPILER_OPTIMIZATION_ASSERTIONS_DISABLE=y
-CONFIG_COMPILER_ORPHAN_SECTIONS_PLACE=y
 CONFIG_BT_ENABLED=y
 CONFIG_BT_NIMBLE_ENABLED=y
 CONFIG_BT_NIMBLE_MEM_ALLOC_MODE_DEFAULT=y
@@ -32,12 +31,17 @@
 CONFIG_I2S_ISR_IRAM_SAFE=y
 CONFIG_SPI_SLAVE_ISR_IN_IRAM=n
 CONFIG_UART_ISR_IN_IRAM=y
+CONFIG_ETH_RMII_CLK_OUTPUT=y
+CONFIG_ETH_RMII_CLK_OUTPUT_GPIO0=y
 CONFIG_ETH_SPI_ETHERNET_DM9051=y
 CONFIG_ETH_SPI_ETHERNET_W5500=y
 CONFIG_ESP_HTTP_CLIENT_ENABLE_HTTPS=n
 CONFIG_ESP_SLEEP_GPIO_RESET_WORKAROUND=y
 CONFIG_XTAL_FREQ_AUTO=y
 CONFIG_ESP_PHY_CALIBRATION_AND_DATA_STORAGE=n
+CONFIG_SPIRAM=y
+CONFIG_SPIRAM_IGNORE_NOTFOUND=y
+CONFIG_SPIRAM_USE_CAPS_ALLOC=y
 CONFIG_ESP_DEFAULT_CPU_FREQ_MHZ_240=y
 CONFIG_ESP_INT_WDT=n
 CONFIG_ESP_TASK_WDT_INIT=n
@@ -46,8 +50,6 @@
 CONFIG_ESP_WIFI_DYNAMIC_TX_BUFFER_NUM=16
 CONFIG_ESP_WIFI_NVS_ENABLED=n
 CONFIG_ESP_WIFI_TASK_PINNED_TO_CORE_1=y
-CONFIG_ESP_WIFI_IRAM_OPT=n
-CONFIG_ESP_WIFI_GMAC_SUPPORT=n
 CONFIG_FATFS_LFN_HEAP=y
 CONFIG_FREERTOS_THREAD_LOCAL_STORAGE_POINTERS=3
 CONFIG_FREERTOS_IDLE_TASK_STACKSIZE=1024
@@ -57,14 +59,11 @@
 CONFIG_LWIP_LOCAL_HOSTNAME="toit"
 CONFIG_LWIP_DNS_SUPPORT_MDNS_QUERIES=n
 CONFIG_LWIP_TCP_SYNMAXRTX=6
-CONFIG_LWIP_HOOK_IP6_INPUT_NONE=y
 CONFIG_MBEDTLS_SSL_IN_CONTENT_LEN=7800
 CONFIG_MBEDTLS_SSL_OUT_CONTENT_LEN=3700
 CONFIG_MBEDTLS_X509_TRUSTED_CERT_CALLBACK=y
-CONFIG_MBEDTLS_ECP_RESTARTABLE=y
 CONFIG_MBEDTLS_HARDWARE_MPI=n
 CONFIG_MBEDTLS_TLS_CLIENT_ONLY=y
-CONFIG_MBEDTLS_ECP_FIXED_POINT_OPTIM=y
 CONFIG_MBEDTLS_POLY1305_C=y
 CONFIG_MBEDTLS_CHACHA20_C=y
 CONFIG_MBEDTLS_CHACHAPOLY_C=y
@@ -74,4 +73,5 @@
 CONFIG_SPI_FLASH_LOG_FAILED_WRITE=y
 CONFIG_SPI_FLASH_WARN_SETTING_ZERO_TO_ONE=y
 CONFIG_WS_TRANSPORT=n
+CONFIG_TOIT_INTERPRETER_IN_IRAM=n
 CONFIG_TOIT_INTERPRETER_HELPERS_IN_IRAM=n
```

## variants/esp32-eth-clk-out0/sdkconfig.defaults.patch
```kconfig
--- toit/toolchains/esp32/sdkconfig.defaults
+++ synthesized/esp32-eth-clk-out0/sdkconfig.defaults
@@ -31,6 +31,8 @@
 CONFIG_ESP_ERR_TO_NAME_LOOKUP=n
 CONFIG_SPI_SLAVE_ISR_IN_IRAM=n
 CONFIG_UART_ISR_IN_IRAM=y
+CONFIG_ETH_RMII_CLK_OUTPUT=y
+CONFIG_ETH_RMII_CLK_OUTPUT_GPIO0=y
 CONFIG_ETH_SPI_ETHERNET_DM9051=y
 CONFIG_ETH_SPI_ETHERNET_W5500=y
 CONFIG_ESP_HTTP_CLIENT_ENABLE_HTTPS=n
@@ -46,7 +48,6 @@
 CONFIG_ESP_WIFI_NVS_ENABLED=n
 CONFIG_ESP_WIFI_TASK_PINNED_TO_CORE_1=y
 CONFIG_ESP_WIFI_IRAM_OPT=n
-CONFIG_ESP_WIFI_GMAC_SUPPORT=n
 CONFIG_FATFS_LFN_HEAP=y
 CONFIG_FREERTOS_THREAD_LOCAL_STORAGE_POINTERS=3
 CONFIG_FREERTOS_IDLE_TASK_STACKSIZE=1024
@@ -63,7 +64,6 @@
 CONFIG_MBEDTLS_SSL_IN_CONTENT_LEN=7800
 CONFIG_MBEDTLS_SSL_OUT_CONTENT_LEN=3700
 CONFIG_MBEDTLS_X509_TRUSTED_CERT_CALLBACK=y
-CONFIG_MBEDTLS_ECP_RESTARTABLE=y
 CONFIG_MBEDTLS_HARDWARE_MPI=n
 CONFIG_MBEDTLS_TLS_CLIENT_ONLY=y
 CONFIG_MBEDTLS_POLY1305_C=y
```

## variants/esp32-eth-clk-out17-spiram/sdkconfig.defaults.patch
```kconfig
--- toit/toolchains/esp32/sdkconfig.defaults
+++ synthesized/esp32-eth-clk-out17-spiram/sdkconfig.defaults
@@ -31,12 +31,16 @@
 CONFIG_I2S_ISR_IRAM_SAFE=y
 CONFIG_SPI_SLAVE_ISR_IN_IRAM=n
 CONFIG_UART_ISR_IN_IRAM=y
+CONFIG_ETH_RMII_CLK_OUTPUT=y
 CONFIG_ETH_SPI_ETHERNET_DM9051=y
 CONFIG_ETH_SPI_ETHERNET_W5500=y
 CONFIG_ESP_HTTP_CLIENT_ENABLE_HTTPS=n
 CONFIG_ESP_SLEEP_GPIO_RESET_WORKAROUND=y
 CONFIG_XTAL_FREQ_AUTO=y
 CONFIG_ESP_PHY_CALIBRATION_AND_DATA_STORAGE=n
+CONFIG_SPIRAM=y
+CONFIG_SPIRAM_IGNORE_NOTFOUND=y
+CONFIG_SPIRAM_USE_CAPS_ALLOC=y
 CONFIG_ESP_DEFAULT_CPU_FREQ_MHZ_240=y
 CONFIG_ESP_INT_WDT=n
 CONFIG_ESP_TASK_WDT_INIT=n
@@ -45,8 +49,6 @@
 CONFIG_ESP_WIFI_DYNAMIC_TX_BUFFER_NUM=16
 CONFIG_ESP_WIFI_NVS_ENABLED=n
 CONFIG_ESP_WIFI_TASK_PINNED_TO_CORE_1=y
-CONFIG_ESP_WIFI_IRAM_OPT=n
-CONFIG_ESP_WIFI_GMAC_SUPPORT=n
 CONFIG_FATFS_LFN_HEAP=y
 CONFIG_FREERTOS_THREAD_LOCAL_STORAGE_POINTERS=3
 CONFIG_FREERTOS_IDLE_TASK_STACKSIZE=1024
@@ -63,7 +65,6 @@
 CONFIG_MBEDTLS_SSL_IN_CONTENT_LEN=7800
 CONFIG_MBEDTLS_SSL_OUT_CONTENT_LEN=3700
 CONFIG_MBEDTLS_X509_TRUSTED_CERT_CALLBACK=y
-CONFIG_MBEDTLS_ECP_RESTARTABLE=y
 CONFIG_MBEDTLS_HARDWARE_MPI=n
 CONFIG_MBEDTLS_TLS_CLIENT_ONLY=y
 CONFIG_MBEDTLS_POLY1305_C=y
@@ -75,4 +76,5 @@
 CONFIG_SPI_FLASH_LOG_FAILED_WRITE=y
 CONFIG_SPI_FLASH_WARN_SETTING_ZERO_TO_ONE=y
 CONFIG_WS_TRANSPORT=n
+CONFIG_TOIT_INTERPRETER_IN_IRAM=n
 CONFIG_TOIT_INTERPRETER_HELPERS_IN_IRAM=n
```

## variants/esp32-log-wifi/sdkconfig.defaults.patch
```kconfig
--- /home/flo/code/envelopes/../opentoit/toolchains/esp32/sdkconfig.defaults	2023-10-25 16:02:07.900402881 +0200
+++ synthesized/esp32-log-wifi/sdkconfig.defaults	2023-10-25 16:13:45.229587009 +0200
@@ -52,7 +52,7 @@
 CONFIG_FREERTOS_USE_TRACE_FACILITY=y
 CONFIG_FREERTOS_ISR_STACKSIZE=2096
 CONFIG_FREERTOS_PLACE_FUNCTIONS_INTO_FLASH=y
-CONFIG_LOG_DEFAULT_LEVEL_ERROR=y
+CONFIG_LOG_DEFAULT_LEVEL_DEBUG=y
 # CONFIG_LOG_COLORS is not set
 CONFIG_LWIP_LOCAL_HOSTNAME="toit"
 # CONFIG_LWIP_DNS_SUPPORT_MDNS_QUERIES is not set
@@ -76,4 +76,5 @@
 CONFIG_SPI_FLASH_LOG_FAILED_WRITE=y
 CONFIG_SPI_FLASH_WARN_SETTING_ZERO_TO_ONE=y
 # CONFIG_WS_TRANSPORT is not set
+CONFIG_WPA_DEBUG_PRINT=y
 # CONFIG_TOIT_INTERPRETER_HELPERS_IN_IRAM is not set
```

## variants/esp32-other-name/sdkconfig.defaults.patch
```kconfig
--- toolchains/esp32/sdkconfig.defaults	2024-02-19 14:17:25.286885071 +0400
+++ toolchains/esp32-name/sdkconfig.defaults	2024-02-26 20:37:54.895785478 +0400
@@ -18,7 +18,7 @@
 CONFIG_BT_NIMBLE_MAX_CCCDS=3
 CONFIG_BT_NIMBLE_PINNED_TO_CORE_1=y
 CONFIG_BT_NIMBLE_NVS_PERSIST=y
-CONFIG_BT_NIMBLE_SVC_GAP_DEVICE_NAME="toit"
+CONFIG_BT_NIMBLE_SVC_GAP_DEVICE_NAME="other-name"
 CONFIG_BT_NIMBLE_SVC_GAP_APPEARANCE=0x0
 CONFIG_BT_NIMBLE_ACL_BUF_COUNT=10
 CONFIG_BTDM_CTRL_BLE_MAX_CONN=2
@@ -53,7 +53,7 @@
 CONFIG_FREERTOS_PLACE_FUNCTIONS_INTO_FLASH=y
 CONFIG_LOG_DEFAULT_LEVEL_ERROR=y
 # CONFIG_LOG_COLORS is not set
-CONFIG_LWIP_LOCAL_HOSTNAME="toit"
+CONFIG_LWIP_LOCAL_HOSTNAME="other-name"
 # CONFIG_LWIP_DNS_SUPPORT_MDNS_QUERIES is not set
 CONFIG_LWIP_TCP_SYNMAXRTX=6
 CONFIG_LWIP_TCP_MSS=1410
```

## variants/esp32-qemu/sdkconfig.defaults.patch
```kconfig
--- toit/toolchains/esp32/sdkconfig.defaults
+++ synthesized/esp32-qemu/sdkconfig.defaults
@@ -33,6 +33,7 @@
 CONFIG_UART_ISR_IN_IRAM=y
 CONFIG_ETH_SPI_ETHERNET_DM9051=y
 CONFIG_ETH_SPI_ETHERNET_W5500=y
+CONFIG_ETH_USE_OPENETH=y
 CONFIG_ESP_HTTP_CLIENT_ENABLE_HTTPS=n
 CONFIG_ESP_SLEEP_GPIO_RESET_WORKAROUND=y
 CONFIG_XTAL_FREQ_AUTO=y
@@ -46,7 +47,6 @@
 CONFIG_ESP_WIFI_NVS_ENABLED=n
 CONFIG_ESP_WIFI_TASK_PINNED_TO_CORE_1=y
 CONFIG_ESP_WIFI_IRAM_OPT=n
-CONFIG_ESP_WIFI_GMAC_SUPPORT=n
 CONFIG_FATFS_LFN_HEAP=y
 CONFIG_FREERTOS_THREAD_LOCAL_STORAGE_POINTERS=3
 CONFIG_FREERTOS_IDLE_TASK_STACKSIZE=1024
@@ -60,7 +60,6 @@
 CONFIG_MBEDTLS_SSL_IN_CONTENT_LEN=7800
 CONFIG_MBEDTLS_SSL_OUT_CONTENT_LEN=3700
 CONFIG_MBEDTLS_X509_TRUSTED_CERT_CALLBACK=y
-CONFIG_MBEDTLS_ECP_RESTARTABLE=y
 CONFIG_MBEDTLS_HARDWARE_MPI=n
 CONFIG_MBEDTLS_TLS_CLIENT_ONLY=y
 CONFIG_MBEDTLS_POLY1305_C=y
```

## variants/esp32-sedisto/sdkconfig.defaults.patch
```kconfig
--- toolchains/esp32/sdkconfig.defaults	2024-02-14 13:01:21.464253095 +0100
+++ toolchains/esp32-sedisto/sdkconfig.defaults	2024-02-14 13:02:23.710920353 +0100
@@ -73,4 +73,8 @@
 CONFIG_SPI_FLASH_LOG_FAILED_WRITE=y
 CONFIG_SPI_FLASH_WARN_SETTING_ZERO_TO_ONE=y
 # CONFIG_WS_TRANSPORT is not set
+# CONFIG_TOIT_BYTE_DISPLAY is not set
+# CONFIG_TOIT_BIT_DISPLAY is not set
+# CONFIG_TOIT_FONT is not set
+# CONFIG_TOIT_FATFS is not set
 # CONFIG_TOIT_INTERPRETER_HELPERS_IN_IRAM is not set
```

## variants/esp32-tls-server/sdkconfig.defaults.patch
```kconfig
--- toit/toolchains/esp32/sdkconfig.defaults	2025-08-20 22:17:50.661701198 +0200
+++ synthesized/esp32-tls-server/sdkconfig.defaults	2025-08-20 22:19:19.846923937 +0200
@@ -9,7 +9,6 @@
 CONFIG_PARTITION_TABLE_CUSTOM=y
 CONFIG_COMPILER_OPTIMIZATION_SIZE=y
 CONFIG_COMPILER_OPTIMIZATION_ASSERTIONS_DISABLE=y
-CONFIG_COMPILER_ORPHAN_SECTIONS_PLACE=y
 CONFIG_BT_ENABLED=y
 CONFIG_BT_NIMBLE_ENABLED=y
 CONFIG_BT_NIMBLE_MEM_ALLOC_MODE_DEFAULT=y
@@ -47,7 +46,6 @@
 CONFIG_ESP_WIFI_NVS_ENABLED=n
 CONFIG_ESP_WIFI_TASK_PINNED_TO_CORE_1=y
 CONFIG_ESP_WIFI_IRAM_OPT=n
-CONFIG_ESP_WIFI_GMAC_SUPPORT=n
 CONFIG_FATFS_LFN_HEAP=y
 CONFIG_FREERTOS_THREAD_LOCAL_STORAGE_POINTERS=3
 CONFIG_FREERTOS_IDLE_TASK_STACKSIZE=1024
@@ -57,14 +55,10 @@
 CONFIG_LWIP_LOCAL_HOSTNAME="toit"
 CONFIG_LWIP_DNS_SUPPORT_MDNS_QUERIES=n
 CONFIG_LWIP_TCP_SYNMAXRTX=6
-CONFIG_LWIP_HOOK_IP6_INPUT_NONE=y
 CONFIG_MBEDTLS_SSL_IN_CONTENT_LEN=7800
 CONFIG_MBEDTLS_SSL_OUT_CONTENT_LEN=3700
 CONFIG_MBEDTLS_X509_TRUSTED_CERT_CALLBACK=y
-CONFIG_MBEDTLS_ECP_RESTARTABLE=y
 CONFIG_MBEDTLS_HARDWARE_MPI=n
-CONFIG_MBEDTLS_TLS_CLIENT_ONLY=y
-CONFIG_MBEDTLS_ECP_FIXED_POINT_OPTIM=y
 CONFIG_MBEDTLS_POLY1305_C=y
 CONFIG_MBEDTLS_CHACHA20_C=y
 CONFIG_MBEDTLS_CHACHAPOLY_C=y
```

## variants/esp32s3-cdc-no-spiram/sdkconfig.defaults.patch
```kconfig
--- toolchains/esp32s3/sdkconfig.defaults	2024-03-28 11:11:46.249705447 +0100
+++ toolchains/esp32s3-cdc/sdkconfig.defaults	2024-04-28 20:24:14.686259012 +0200
@@ -31,14 +31,14 @@
 # CONFIG_ESP_HTTP_CLIENT_ENABLE_HTTPS is not set
 # CONFIG_ESP_PHY_CALIBRATION_AND_DATA_STORAGE is not set
 CONFIG_ESP_PHY_REDUCE_TX_POWER=y
-CONFIG_SPIRAM=y
-CONFIG_SPIRAM_IGNORE_NOTFOUND=y
-CONFIG_SPIRAM_RODATA_PADDING=2097152
 CONFIG_ESP_DEFAULT_CPU_FREQ_MHZ_240=y
+CONFIG_ESP_CONSOLE_USB_CDC=y
+CONFIG_ESP_CONSOLE_USB_CDC_SUPPORT_ETS_PRINTF=y
 # CONFIG_ESP_INT_WDT is not set
 # CONFIG_ESP_TASK_WDT_INIT is not set
 CONFIG_ESP_IPC_TASK_STACK_SIZE=1024
 CONFIG_ESP32_WIFI_DYNAMIC_RX_BUFFER_NUM=16
+CONFIG_ESP32_WIFI_STATIC_TX_BUFFER=y
 # CONFIG_ESP32_WIFI_NVS_ENABLED is not set
 CONFIG_ESP32_WIFI_TASK_PINNED_TO_CORE_1=y
 CONFIG_FATFS_LFN_HEAP=y
```

## variants/esp32s3-cdc/sdkconfig.defaults.patch
```kconfig
--- toolchains/esp32s3/sdkconfig.defaults	2024-03-28 11:11:46.249705447 +0100
+++ toolchains/esp32s3-cdc/sdkconfig.defaults	2024-04-28 19:26:40.803000066 +0200
@@ -35,6 +35,8 @@
 CONFIG_SPIRAM_IGNORE_NOTFOUND=y
 CONFIG_SPIRAM_RODATA_PADDING=2097152
 CONFIG_ESP_DEFAULT_CPU_FREQ_MHZ_240=y
+CONFIG_ESP_CONSOLE_USB_CDC=y
+CONFIG_ESP_CONSOLE_USB_CDC_SUPPORT_ETS_PRINTF=y
 # CONFIG_ESP_INT_WDT is not set
 # CONFIG_ESP_TASK_WDT_INIT is not set
 CONFIG_ESP_IPC_TASK_STACK_SIZE=1024
```

## variants/esp32s3-consibio-spiram-octo/sdkconfig.defaults.patch
```kconfig
--- toit/toolchains/esp32s3/sdkconfig.defaults	2025-08-20 22:17:50.662701198 +0200
+++ synthesized/esp32s3-consibio-spiram-octo/sdkconfig.defaults	2025-08-20 22:18:42.845977840 +0200
@@ -6,24 +6,12 @@
 CONFIG_BOOTLOADER_APP_ROLLBACK_ENABLE=y
 CONFIG_BOOTLOADER_SKIP_VALIDATE_IN_DEEP_SLEEP=y
 CONFIG_APP_COMPILE_TIME_DATE=n
-CONFIG_ESPTOOLPY_FLASHSIZE_4MB=y
+CONFIG_ESPTOOLPY_OCT_FLASH=y
+CONFIG_ESPTOOLPY_FLASH_SAMPLE_MODE_STR=y
+CONFIG_ESPTOOLPY_FLASHSIZE_32MB=y
 CONFIG_PARTITION_TABLE_CUSTOM=y
 CONFIG_COMPILER_OPTIMIZATION_SIZE=y
 CONFIG_COMPILER_OPTIMIZATION_ASSERTIONS_DISABLE=y
-CONFIG_COMPILER_ORPHAN_SECTIONS_PLACE=y
-CONFIG_BT_ENABLED=y
-CONFIG_BT_NIMBLE_ENABLED=y
-CONFIG_BT_NIMBLE_MEM_ALLOC_MODE_DEFAULT=y
-CONFIG_BT_NIMBLE_LOG_LEVEL_NONE=y
-CONFIG_BT_NIMBLE_MAX_CONNECTIONS=2
-CONFIG_BT_NIMBLE_MAX_BONDS=4
-CONFIG_BT_NIMBLE_MAX_CCCDS=3
-CONFIG_BT_NIMBLE_PINNED_TO_CORE_1=y
-CONFIG_BT_NIMBLE_NVS_PERSIST=y
-CONFIG_BT_NIMBLE_SVC_GAP_DEVICE_NAME="toit"
-CONFIG_BT_NIMBLE_SVC_GAP_APPEARANCE=0x0
-CONFIG_BT_NIMBLE_TRANSPORT_ACL_FROM_LL_COUNT=10
-CONFIG_BT_CTRL_BLE_MAX_ACT=10
 CONFIG_I2S_ISR_IRAM_SAFE=y
 CONFIG_SPI_SLAVE_ISR_IN_IRAM=n
 CONFIG_UART_ISR_IN_IRAM=y
@@ -33,13 +21,13 @@
 CONFIG_ESP_PHY_CALIBRATION_AND_DATA_STORAGE=n
 CONFIG_ESP_PHY_REDUCE_TX_POWER=y
 CONFIG_SPIRAM=y
+CONFIG_SPIRAM_MODE_OCT=y
 CONFIG_SPIRAM_IGNORE_NOTFOUND=y
 CONFIG_ESP_DEFAULT_CPU_FREQ_MHZ_240=y
 CONFIG_ESP_INT_WDT=n
 CONFIG_ESP_TASK_WDT_INIT=n
 CONFIG_ESP_IPC_TASK_STACK_SIZE=1024
 CONFIG_ESP_WIFI_DYNAMIC_RX_BUFFER_NUM=16
-CONFIG_ESP_WIFI_STATIC_TX_BUFFER=y
 CONFIG_ESP_WIFI_NVS_ENABLED=n
 CONFIG_ESP_WIFI_TASK_PINNED_TO_CORE_1=y
 CONFIG_ESP_WIFI_GMAC_SUPPORT=n
@@ -52,14 +40,12 @@
 CONFIG_LWIP_LOCAL_HOSTNAME="toit"
 CONFIG_LWIP_DNS_SUPPORT_MDNS_QUERIES=n
 CONFIG_LWIP_TCP_SYNMAXRTX=6
-CONFIG_LWIP_HOOK_IP6_INPUT_NONE=y
 CONFIG_MBEDTLS_SSL_IN_CONTENT_LEN=7800
 CONFIG_MBEDTLS_SSL_OUT_CONTENT_LEN=3700
 CONFIG_MBEDTLS_X509_TRUSTED_CERT_CALLBACK=y
 CONFIG_MBEDTLS_ECP_RESTARTABLE=y
 CONFIG_MBEDTLS_HARDWARE_MPI=n
 CONFIG_MBEDTLS_TLS_CLIENT_ONLY=y
-CONFIG_MBEDTLS_ECP_FIXED_POINT_OPTIM=y
 CONFIG_MBEDTLS_POLY1305_C=y
 CONFIG_MBEDTLS_CHACHA20_C=y
 CONFIG_MBEDTLS_CHACHAPOLY_C=y
```
