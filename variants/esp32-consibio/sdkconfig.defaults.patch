## variants/esp32s3-spiram-octo/sdkconfig.defaults.patch
```kconfig
--- toit/toolchains/esp32s3/sdkconfig.defaults
+++ synthesized/esp32s3-spiram-octo/sdkconfig.defaults
@@ -32,6 +32,7 @@
 CONFIG_ESP_PHY_CALIBRATION_AND_DATA_STORAGE=n
 CONFIG_ESP_PHY_REDUCE_TX_POWER=y
 CONFIG_SPIRAM=y
+CONFIG_SPIRAM_MODE_OCT=y
 CONFIG_SPIRAM_IGNORE_NOTFOUND=y
 CONFIG_ESP_DEFAULT_CPU_FREQ_MHZ_240=y
 CONFIG_ESP_INT_WDT=n
@@ -40,7 +41,6 @@
 CONFIG_ESP_WIFI_DYNAMIC_RX_BUFFER_NUM=16
 CONFIG_ESP_WIFI_NVS_ENABLED=n
 CONFIG_ESP_WIFI_TASK_PINNED_TO_CORE_1=y
-CONFIG_ESP_WIFI_GMAC_SUPPORT=n
 CONFIG_FATFS_LFN_HEAP=y
 CONFIG_FREERTOS_THREAD_LOCAL_STORAGE_POINTERS=3
 CONFIG_FREERTOS_IDLE_TASK_STACKSIZE=1024
@@ -54,14 +54,11 @@
 CONFIG_LWIP_TCP_MSS=1410
 CONFIG_LWIP_TCP_SND_BUF_DEFAULT=5640
 CONFIG_LWIP_TCP_WND_DEFAULT=5640
-CONFIG_LWIP_HOOK_IP6_INPUT_NONE=y
 CONFIG_MBEDTLS_SSL_IN_CONTENT_LEN=7800
 CONFIG_MBEDTLS_SSL_OUT_CONTENT_LEN=3700
 CONFIG_MBEDTLS_X509_TRUSTED_CERT_CALLBACK=y
-CONFIG_MBEDTLS_ECP_RESTARTABLE=y
 CONFIG_MBEDTLS_HARDWARE_MPI=n
 CONFIG_MBEDTLS_TLS_CLIENT_ONLY=y
-CONFIG_MBEDTLS_ECP_FIXED_POINT_OPTIM=y
 CONFIG_MBEDTLS_POLY1305_C=y
 CONFIG_MBEDTLS_CHACHA20_C=y
 CONFIG_MBEDTLS_CHACHAPOLY_C=y
```
